#include <Arduino.h>

// =====================================================================
//  CSV PLAYBACK SIMULATOR — pipe2_telemetry_20260417_114732
//
//  Replays real telemetry from the CSV log, exact timing preserved.
//  Waits silently after power-up until ARM command ('f') is received.
//  GPS tracks corrected drift: launch site → actual landing coords.
//  Landing coordinates: 49°48'53.3"N  8°51'38.9"E
//
//  Commands:
//    f / F  — ARM: start flight playback (resets if already playing)
//    g / G  — DISARM: stop and wait for next ARM
//    p / P  — force one telemetry packet now
// =====================================================================

// ---- Telemetry packet struct -----------------------------------------
struct TelemetryPacket {
  uint8_t  temperature;
  uint8_t  subsystem_status;
  uint8_t  flight_mode;
  uint8_t  low_power_mode;
  uint8_t  status_events;
  float    acceleration;
  float    height_pressure;
  float    height_gnss;
  float    lat_gnss;
  float    lon_gnss;
  float    battery_voltage;
  int16_t  rssi;
  uint16_t time_since_last_packet;
  uint32_t delay_ms;
};

// ---- Flight data (played once after ARM) ----------------------------
static const TelemetryPacket FLIGHT[] PROGMEM = {
  {0,3,1,0,4,-1.0000f,0.00f,0.00f,49.8112789f,8.8553847f,6.2f,-52,125,123UL},
  {0,3,1,0,4,-1.0000f,0.00f,0.00f,49.8112792f,8.8553853f,6.2f,-52,124,122UL},
  {0,3,1,0,4,-1.0000f,0.00f,0.00f,49.8112796f,8.8553858f,6.2f,-52,126,128UL},
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  {0,3,0,0,12,-2.0000f,0.00f,0.00f,49.8148056f,8.8608056f,6.2f,-73,125,126UL}
};
static const uint16_t FLIGHT_LEN = sizeof(FLIGHT) / sizeof(FLIGHT[0]);

// ---- State ----------------------------------------------------------
bool          armed        = false;
uint16_t      pkt_index    = 0;
unsigned long next_send_ms = 0;

// ---- Helper: load a packet from PROGMEM ----------------------------
TelemetryPacket load_packet(uint16_t idx) {
  TelemetryPacket p;
  memcpy_P(&p, &FLIGHT[idx], sizeof(TelemetryPacket));
  return p;
}

// ---- Helper: send one packet on Serial ------------------------------
void send_packet(const TelemetryPacket& p) {
  Serial.print(F("temperature > 80 C: "));      Serial.println(p.temperature);
  Serial.print(F("subsystem_status: "));        Serial.println(p.subsystem_status);
  Serial.print(F("flight_mode: "));             Serial.println(p.flight_mode);
  Serial.print(F("low_power_mode: "));          Serial.println(p.low_power_mode);
  Serial.print(F("status_events: "));           Serial.println(p.status_events);
  Serial.print(F("acceleration: "));            Serial.println(p.acceleration, 4);
  Serial.print(F("height_pressure: "));         Serial.println(p.height_pressure);
  Serial.print(F("height_gnss: "));             Serial.println(p.height_gnss);
  Serial.print(F("lat_gnss: "));                Serial.println(p.lat_gnss, 7);
  Serial.print(F("lon_gnss: "));                Serial.println(p.lon_gnss, 7);
  Serial.print(F("battery_voltage: "));         Serial.println(p.battery_voltage);
  Serial.print(F("rssi: "));                    Serial.println(p.rssi);
  Serial.print(F("time_since_last_packet: "));  Serial.println(p.time_since_last_packet);
}

// ---- Command normalizer --------------------------------------------
char normalize_cmd(char c) {
  return (c >= 'A' && c <= 'Z') ? c + 32 : c;
}

// ---- Arduino entry points ------------------------------------------
void setup() {
  Serial.begin(115200);
}

void loop() {
  unsigned long now = millis();

  // --- Command parser ---
  while (Serial.available()) {
    char cmd = normalize_cmd(Serial.read());
    switch (cmd) {

      case 'f':   // ARM — begin flight playback
        armed        = true;
        pkt_index    = 0;
        next_send_ms = now;
        break;

      case 'g':   // DISARM — stop playback, wait for next ARM
        armed     = false;
        pkt_index = 0;
        break;

      case 'p': { // force-print current packet immediately
        if (armed && pkt_index < FLIGHT_LEN) {
          send_packet(load_packet(pkt_index));
        }
        break;
      }

      default:
        break;
    }
  }

  // --- Scheduled packet send ---
  if (armed && (long)(now - next_send_ms) >= 0) {
    if (pkt_index < FLIGHT_LEN) {
      TelemetryPacket p = load_packet(pkt_index);
      send_packet(p);
      next_send_ms = now + p.delay_ms;
      pkt_index++;
    } else {
      // Flight finished — disarm and wait
      armed     = false;
      pkt_index = 0;
    }
  }
}
